## config/west.yml
```yaml
manifest:
  defaults:
    revision: v0.3
  remotes:
    - name: zmkfirmware
      url-base: https://github.com/zmkfirmware
    - name: petejohanson
      url-base: https://github.com/petejohanson
  projects:
    - name: zmk
      remote: zmkfirmware
      import: app/west.yml
    # Cirque Pinnacle trackpad driver (ZMK v0.3's Zephyr 3.5 has none in-tree)
    - name: cirque-input-module
      remote: petejohanson
      revision: 0de55f36bc720b5be3d8880dc856d4d78baf5214
  self:
    path: config
```
